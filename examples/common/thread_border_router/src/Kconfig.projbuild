## examples/common/thread_border_router/src/Kconfig.projbuild
```kconfig
menu "UCSC Thread-Ascon Border Router"

    config TX_POWER
      int 'Set the 802.15.4 TX power used by OpenThread'
      range -128 127
      default 20
      help
          Set the 802.15.4 transmission power (in dBm) for OpenThread.
          The recommended TX power values are 20 dBm, 9 dBm, 0 dBm, and -25 dBm.

endmenu
```
